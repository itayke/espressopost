## sdkconfig.defaults
```kconfig
# --- Target ---
CONFIG_IDF_TARGET="esp32s3"

# --- Flash & PSRAM (Waveshare ESP32-S3R8: 16MB QIO flash + 8MB OPI PSRAM) ---
CONFIG_ESPTOOLPY_FLASHSIZE_16MB=y
CONFIG_ESPTOOLPY_FLASHMODE_QIO=y
CONFIG_ESPTOOLPY_FLASHFREQ_80M=y
CONFIG_SPIRAM=y
CONFIG_SPIRAM_MODE_OCT=y
CONFIG_SPIRAM_SPEED_80M=y
CONFIG_SPIRAM_USE_MALLOC=y
CONFIG_SPIRAM_TRY_ALLOCATE_WIFI_LWIP=y

# --- CPU ---
CONFIG_ESP_DEFAULT_CPU_FREQ_MHZ_240=y

# --- Custom partition table (see partitions.csv) ---
CONFIG_PARTITION_TABLE_CUSTOM=y
CONFIG_PARTITION_TABLE_CUSTOM_FILENAME="partitions.csv"

# --- LittleFS (registry component will pull this in once added) ---
# Placeholder: enable explicitly when storage component lands.

# --- Cloud sync: WiFi (STA) + TLS to the Google Apps Script Web App ---
# WiFi was not enabled before this milestone. The LWIP-in-PSRAM hook above was
# left on in anticipation. The certificate bundle is what lets esp_http_client
# validate script.google.com and the script.googleusercontent.com host its
# /exec redirect lands on without pinning a single cert; the FULL bundle
# includes the Google/GTS roots.
CONFIG_ESP_WIFI_ENABLED=y
CONFIG_ESP_HTTP_CLIENT_ENABLE_HTTPS=y
CONFIG_MBEDTLS_CERTIFICATE_BUNDLE=y
CONFIG_MBEDTLS_CERTIFICATE_BUNDLE_DEFAULT_FULL=y

# --- Logging ---
CONFIG_LOG_DEFAULT_LEVEL_INFO=y
CONFIG_LOG_COLORS=y

# --- C++ ---
CONFIG_COMPILER_CXX_EXCEPTIONS=n
CONFIG_COMPILER_CXX_RTTI=n

# --- FreeRTOS tick at 1kHz so LVGL animations stay smooth ---
CONFIG_FREERTOS_HZ=1000

# --- LVGL fonts ---
# Only Montserrat 14 is enabled by default; everything else used on the
# Report screen has to be requested here so the linker can find it.
#   24 pt — Post / Menu / Submit / Back buttons and the ✕ cancel glyph
#   36 pt — the preset editor's value readouts (Weight In/Out + brew time)
#   46 pt — the big "30s" BREW TIME value, the centered grind value (idle +
#           post) and the climate-tile value readouts (TEMP / HUMIDITY /
#           PRESSURE)
CONFIG_LV_FONT_MONTSERRAT_24=y
CONFIG_LV_FONT_MONTSERRAT_36=y
CONFIG_LV_FONT_MONTSERRAT_46=y

# --- LVGL memory: custom allocator backed by PSRAM (components/display/lv_port_mem.c) ---
# LVGL's pool, style data, and image/snapshot buffers are CPU-only (never DMA'd
# to the panel — the final pixels land in display.cpp's internal draw buffers),
# so they live in PSRAM. This is mandatory now that Wi-Fi is enabled: the CO5300
# QSPI panel can only DMA color data from INTERNAL RAM, so the two ~46 KB draw
# buffers must stay internal, and a 128 KB internal LVGL pool + those buffers +
# the Wi-Fi stack no longer fit in internal RAM. Custom malloc removes the fixed
# pool entirely (allocations grow into the 8 MB PSRAM as needed), which also
# lifts the old per-screen pool-exhaustion ceiling.
CONFIG_LV_USE_CUSTOM_MALLOC=y

# --- LVGL extra modules ---
# Snapshot bakes the rotated-number ring into a single 466×466 RGB565 sprite
# at boot, so dialing the grind ring is one lv_image_set_rotation call per
# frame instead of repositioning 31 label widgets. Without this, dragging the
# rim collapses to 3–4 fps.
CONFIG_LV_USE_SNAPSHOT=y

# Float-precision lv_point_precise_t / lv_value_precise_t. ESP32-S3 has an
# FPU, the type stays 4 bytes either way, and svg_to_lvgl.py output + the
# arrow-rotation math both want sub-pixel precision for clean strokes.
CONFIG_LV_USE_FLOAT=y
```
